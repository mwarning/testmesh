## openwrt/geomesh-firmware/Config.in
```kconfig
menu "Configuration"
	depends on PACKAGE_geomesh-firmware

config GEOMESH_FIRMWARE_GATEWAY
	bool "Configure as gateway."
	depends on PACKAGE_geomesh-firmware
	default n

config GEOMESH_FIRMWARE_ALGORITHM
	string "Default routing algorithm."
	depends on PACKAGE_geomesh-firmware
	default "flood-0"

endmenu
```

## openwrt/geomesh/Config.in
```kconfig
menu "Configuration"
	depends on PACKAGE_geomesh

config GEOMESH_ENABLE_DEBUG
	bool "Build in debug mode"
	depends on PACKAGE_geomesh
	default n

endmenu
```

## openwrt/testmesh-firmware/Config.in
```kconfig
menu "Configuration"
	depends on PACKAGE_testmesh-firmware

config TESTMESH_FIRMWARE_GATEWAY
	bool "Configure as gateway."
	depends on PACKAGE_testmesh-firmware
	default n

config TESTMESH_FIRMWARE_ALGORITHM
	string "Default routing algorithm."
	depends on PACKAGE_testmesh-firmware
	default "flood-0"

endmenu
```

## openwrt/testmesh/Config.in
```kconfig
menu "Configuration"
	depends on PACKAGE_testmesh

config TESTMESH_ENABLE_DEBUG
	bool "Build in debug mode"
	depends on PACKAGE_testmesh
	default n

endmenu
```
